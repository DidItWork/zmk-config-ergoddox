## config/boards/shields/ergoddox/Kconfig.defconfig
```kconfig
if SHIELD_ERGODDOX_LEFT

config ZMK_KEYBOARD_NAME
    default "ErgoDDOX"

config ZMK_SPLIT_ROLE_CENTRAL
    default y

endif

if SHIELD_ERGODDOX_LEFT || SHIELD_ERGODDOX_RIGHT

config ZMK_SPLIT
    default y

endif
```

## config/boards/shields/ergoddox/Kconfig.shield
```kconfig
config SHIELD_ERGODDOX_LEFT
    def_bool $(shields_list_contains,ergoddox_left)

config SHIELD_ERGODDOX_RIGHT
    def_bool $(shields_list_contains,ergoddox_right)
```

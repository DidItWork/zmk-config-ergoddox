#include <physical_layouts.dtsi>

/ {
    physical_layout0: physical_layout_0 {
        compatible = "zmk,physical-layout";
        display-name = "Default Layout";
    };

    ergoddox_physical_layout: ergoddox_physical_layout {
        compatible = "zmk,physical-layout";
        display-name = "Ergoddox";
        transform = <&default_transform>;
        kscan = <&kscan0>;
        keys = <&key_physical_atrs 150 100 0 26  0 0 0>
             , <&key_physical_atrs 100 100 150 26  0 0 0>
             , <&key_physical_atrs 100 100 250 10  0 0 0>
             , <&key_physical_atrs 100 100 350 0  0 0 0>
             , <&key_physical_atrs 100 100 450 10  0 0 0>
             , <&key_physical_atrs 100 100 550 26  0 0 0>
             , <&key_physical_atrs 100 100 650 26  0 0 0>

             , <&key_physical_atrs 100 100 1250 26  0 0 0>
             , <&key_physical_atrs 100 100 1350 26  0 0 0>
             , <&key_physical_atrs 100 100 1450 10  0 0 0>
             , <&key_physical_atrs 100 100 1550 0  0 0 0>
             , <&key_physical_atrs 100 100 1650 10  0 0 0>
             , <&key_physical_atrs 100 100 1750 26  0 0 0>
             , <&key_physical_atrs 150 100 1850 26  0 0 0>


             , <&key_physical_atrs 150 100 0 126  0 0 0>
             , <&key_physical_atrs 100 100 150 126  0 0 0>
             , <&key_physical_atrs 100 100 250 110  0 0 0>
             , <&key_physical_atrs 100 100 350 100  0 0 0>
             , <&key_physical_atrs 100 100 450 110  0 0 0>
             , <&key_physical_atrs 100 100 550 126  0 0 0>
             , <&key_physical_atrs 100 150 650 126  0 0 0>

             , <&key_physical_atrs 100 150 1250 126  0 0 0>
             , <&key_physical_atrs 100 100 1350 126  0 0 0>
             , <&key_physical_atrs 100 100 1450 110  0 0 0>
             , <&key_physical_atrs 100 100 1550 100  0 0 0>
             , <&key_physical_atrs 100 100 1650 110  0 0 0>
             , <&key_physical_atrs 100 100 1750 126  0 0 0>
             , <&key_physical_atrs 150 100 1850 126  0 0 0>


             , <&key_physical_atrs 150 100 0 226  0 0 0>
             , <&key_physical_atrs 100 100 150 226  0 0 0>
             , <&key_physical_atrs 100 100 250 210  0 0 0>
             , <&key_physical_atrs 100 100 350 200  0 0 0>
             , <&key_physical_atrs 100 100 450 210  0 0 0>
             , <&key_physical_atrs 100 100 550 226  0 0 0>
             , <&key_physical_atrs 100 100 750 302  0 0 0>

             , <&key_physical_atrs 100 100 1150 302  0 0 0>
             , <&key_physical_atrs 100 100 1350 226  0 0 0>
             , <&key_physical_atrs 100 100 1450 210  0 0 0>
             , <&key_physical_atrs 100 100 1550 200  0 0 0>
             , <&key_physical_atrs 100 100 1650 210  0 0 0>
             , <&key_physical_atrs 100 100 1750 226  0 0 0>
             , <&key_physical_atrs 150 100 1850 226  0 0 0>


             , <&key_physical_atrs 150 100 0 326  0 0 0>
             , <&key_physical_atrs 100 100 150 326  0 0 0>
             , <&key_physical_atrs 100 100 250 310  0 0 0>
             , <&key_physical_atrs 100 100 350 300  0 0 0>
             , <&key_physical_atrs 100 100 450 310  0 0 0>
             , <&key_physical_atrs 100 100 550 326  0 0 0>
             , <&key_physical_atrs 100 150 650 276  0 0 0>
             , <&key_physical_atrs 100 100 754 364  3000 50 50>
             , <&key_physical_atrs 100 100 841 414  3000 50 50>

             , <&key_physical_atrs 100 100 1059 414  -3000 50 50>
             , <&key_physical_atrs 100 100 1146 364  -3000 50 50>
             , <&key_physical_atrs 100 150 1250 276  0 0 0>
             , <&key_physical_atrs 100 100 1350 326  0 0 0>
             , <&key_physical_atrs 100 100 1450 310  0 0 0>
             , <&key_physical_atrs 100 100 1550 300  0 0 0>
             , <&key_physical_atrs 150 100 1650 310  0 0 0>
             , <&key_physical_atrs 150 100 1750 326  0 0 0>
             , <&key_physical_atrs 150 100 1850 326  0 0 0>


             , <&key_physical_atrs 100 100 50 426  0 0 0>
             , <&key_physical_atrs 100 100 150 426  0 0 0>
             , <&key_physical_atrs 100 100 250 410  0 0 0>
             , <&key_physical_atrs 100 100 350 400  0 0 0>
             , <&key_physical_atrs 100 100 450 410  0 0 0>
             , <&key_physical_atrs 100 200 550 426  3000 50 50>
             , <&key_physical_atrs 100 200 679 494  3000 50 50>
             , <&key_physical_atrs 100 100 841 414  3000 50 50>

             , <&key_physical_atrs 100 100 1059 414  -3000 50 50>
             , <&key_physical_atrs 100 100 1146 364  -3000 50 50>
             , <&key_physical_atrs 100 100 1350 326  0 0 0>
             , <&key_physical_atrs 100 100 1450 310  0 0 0>
             , <&key_physical_atrs 100 100 1550 300  0 0 0>
             , <&key_physical_atrs 150 100 1650 310  0 0 0>
             , <&key_physical_atrs 150 100 1750 326  0 0 0>
             , <&key_physical_atrs 150 100 1850 326  0 0 0>
             ;
    };
};